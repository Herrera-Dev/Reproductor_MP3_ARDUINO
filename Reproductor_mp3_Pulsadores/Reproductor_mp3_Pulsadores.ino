
#include <Wire.h>     // libreria para bus I2C
#include <Adafruit_GFX.h>   // libreria para pantallas graficas
#include <Adafruit_SSD1306.h>   // libreria para controlador SSD1306
#define ancho 128
#define alto 64
#define direccion_pantalla 0x3C
#define reset_pantalla -1    // necesario por la libreria pero no usado
Adafruit_SSD1306 display(ancho, alto, &Wire, reset_pantalla);  // crea objeto

// DFPLAYER MINI MP3 - PARLANTE
#include <SoftwareSerial.h>
#include "DFRobotDFPlayerMini.h"
SoftwareSerial mySoftwareSerial(10, 11); // RX, TX
DFRobotDFPlayerMini myDFPlayer;

static const unsigned char imgvol [] PROGMEM = {
  0x04, 0x00, 0x0c, 0x80, 0x3d, 0x40, 0x3d, 0x40, 0x3d, 0x40, 0x3d, 0x40, 0x0c, 0x80, 0x04, 0x00
};
static const unsigned char imgplay [] PROGMEM = {
  0x80, 0xe0, 0xf0, 0xf8, 0xf8, 0xe0, 0xc0, 0x00
};

static const unsigned char imgpause [] PROGMEM = {
  0x00, 0xc8, 0xc8, 0xc8, 0xc8, 0xc8, 0xc8, 0x48
};

static const unsigned char aleatoriov [] PROGMEM = {

  0x00, 0x00, 0xe0, 0xe0, 0x12, 0x20, 0x04, 0x00, 0x08, 0x00, 0x12, 0x20, 0xe0, 0xe0, 0x00, 0x00
};
static const unsigned char aleatoriof [] PROGMEM = {
  0x00, 0x00, 0x00, 0x00, 0x01, 0x80, 0x00, 0xc0, 0x7f, 0xe0, 0x00, 0xc0, 0x01, 0x00, 0x00, 0x00
};

static const unsigned char imgloop [] PROGMEM = {
  0x04, 0x00, 0x07, 0x00, 0x15, 0x80, 0x10, 0x80, 0x10, 0x80, 0x1a, 0x80, 0x0e, 0x00, 0x02, 0x00
};

const unsigned char onda1 [] PROGMEM = {
  0x00, 0x00, 0x00, 0x00, 0x00, 0x00, 0x00, 0x00, 0x00, 0x00, 0x00, 0x00, 0x00, 0x00, 0x00, 0x00,
  0x00, 0x00, 0x00, 0x00, 0x00, 0x00, 0x00, 0x00, 0x00, 0x00, 0x00, 0x00, 0x00, 0x00, 0x00, 0x00,
  0x00, 0x00, 0x00, 0x00, 0x00, 0x00, 0x00, 0x00, 0x00, 0x00, 0x00, 0x00, 0x00, 0x00, 0x00, 0x00,
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  0x00, 0x00, 0x00, 0x00, 0x00
};

const unsigned char onda2 [] PROGMEM = {
  0x00, 0x00, 0x00, 0x00, 0x00, 0x00, 0x00, 0x00, 0x00, 0x00, 0x00, 0x00, 0x00, 0x00, 0x00, 0x00,
  0x00, 0x00, 0x00, 0x00, 0x00, 0x00, 0x00, 0x00, 0x00, 0x00, 0x00, 0x00, 0x00, 0x00, 0x00, 0x00,
  0x00, 0x00, 0x00, 0x00, 0x00, 0x00, 0x00, 0x00, 0x00, 0x00, 0x00, 0x00, 0x00, 0x00, 0x00, 0x00,
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  0x00, 0x00, 0x00, 0x00, 0x00, 0x00, 0x00
};

const unsigned char onda3 [] PROGMEM = {
  0x00, 0x00, 0x00, 0x00, 0x00, 0x00, 0x00, 0x00, 0x00, 0x00, 0x00, 0x00, 0x00, 0x00, 0x00, 0x00,
  0x00, 0x00, 0x00, 0x00, 0x00, 0x00, 0x00, 0x00, 0x00, 0x00, 0x00, 0x00, 0x00, 0x00, 0x00, 0x00,
  0x00, 0x00, 0x00, 0x00, 0x00, 0x00, 0x00, 0x00, 0x00, 0x00, 0x00, 0x00, 0x00, 0x00, 0x00, 0x00,
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  0x00, 0x00, 0x00, 0x00, 0x00, 0x00, 0x00
};

const unsigned char onda4 [] PROGMEM = {
  0x00, 0x00, 0x00, 0x00, 0x00, 0x00, 0x00, 0x00, 0x00, 0x00, 0x00, 0x00, 0x00, 0x00, 0x00, 0x00,
  0x00, 0x00, 0x00, 0x00, 0x00, 0x00, 0x00, 0x00, 0x00, 0x00, 0x00, 0x00, 0x00, 0x00, 0x00, 0x00,
  0x00, 0x00, 0x00, 0x00, 0x00, 0x00, 0x00, 0x00, 0x00, 0x00, 0x00, 0x00, 0x00, 0x00, 0x00, 0x00,
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  0x00, 0x00, 0x00, 0x00, 0x00, 0x00, 0x00
};

#define led 8
#define staModule_apagado 7
#define btnPrevious 6
#define btnPlay_pause 5
#define btnNext 4
#define btnMode1 3
#define btnMode2 2

#define txtTrack "Track:"
#define txtDir "Dir:"

int vVolumen, vVolumen_ant;
int pistaActual;
int contOnda = 0;
boolean staInicio = true;
boolean staPause = false;
boolean staMenu = false;
int posMenu = 1;

String fuente = "USB";
boolean aleatorio = true;
boolean repetir = false;
int folder = 1;


// SETUP ===============================================

void setup() {
  Serial.begin(9600);
  while (!Serial);

  pinMode(led, OUTPUT);
  pinMode(staModule_apagado, INPUT);
  pinMode(btnPrevious, INPUT);
  pinMode(btnPlay_pause, INPUT);
  pinMode(btnNext, INPUT);
  pinMode(btnMode1, INPUT);
  pinMode(btnMode2, INPUT);

  Wire.begin();
  if (!display.begin(SSD1306_SWITCHCAPVCC, direccion_pantalla)) {
    Serial.println(F("Error al localizar el SSD1306"));
    while (true) {
      digitalWrite(led, HIGH);
      delay(1000);
      digitalWrite(led, LOW);
      delay(1000);
    }
  }
  display.display();
  delay(2000); // Esperar que se inicialice bien la libreria

  mySoftwareSerial.begin(9600);
  if (!myDFPlayer.begin(mySoftwareSerial)) {  //Use softwareSerial to communicate with mp3.
    Serial.println(F("Incapaz de empezar"));
    Serial.println(F("1. ¡Vuelva a comprobar la conexión!"));
    Serial.println(F("2. ¡Inserte la tarjeta SD!"));
    while (true) {
      digitalWrite(led, HIGH);
      delay(1000);
      digitalWrite(led, LOW);
      delay(1000);
    }
  }

  display.clearDisplay();      // limpia pantalla
  display.setTextColor(WHITE);
  display.setCursor(centrarText("HERRERA MUSIC"), 24);
  display.print("HERRERA MUSIC");
  display.display();
  delay(2000);

  myDFPlayer.setTimeOut(500);
  vVolumen = map(analogRead(A3), 0, 1023, 0, 30);
  myDFPlayer.volume(vVolumen); //0 - 30
  vVolumen_ant = vVolumen;
  myDFPlayer.outputDevice(DFPLAYER_DEVICE_FLASH);

}

// LOOP ===============================================

void loop() {
  Serial.println(F("-------------------"));

  if (myDFPlayer.available()) {
    printDetail(myDFPlayer.readType(), myDFPlayer.read());
    if (myDFPlayer.readType() > 6) {
      staPause = true;
    }
    digitalWrite(led, HIGH);
  } else {
    digitalWrite(led, LOW);
  }

  //---------------
  if (staInicio) {
    display.clearDisplay();
    display.setTextColor(WHITE);
    display.setCursor(centrarText("* Presionar play *"), 24);
    display.print("* Presionar play *");
    display.display();
    delay(500);
  }

  //---------------
  // INICIO
  if (digitalRead(btnPlay_pause) == HIGH && staInicio) {
    randomSeed(analogRead(A0));
    staInicio = false;

    if (aleatorio) {
      pistaActual = fileAleatorio();
      myDFPlayer.playFolder(folder, pistaActual);;

    } else {
      pistaActual = 0;
      myDFPlayer.loopFolder(folder);
    }
    while (digitalRead(btnPlay_pause) == HIGH);
  }


  // PLAY Y PAUSE
  if (digitalRead(btnPlay_pause) == HIGH && !staInicio) {
    if (staPause) {  // Esta en pause entonces hay que reanudar.
      staPause = false;
      myDFPlayer.start();

    } else {
      staPause = true;
      myDFPlayer.pause();
    }
    while (digitalRead(btnPlay_pause) == HIGH);
  }

  // PREVIOUS
  if (digitalRead(btnPrevious) == HIGH && !staInicio) {

    repetir = false;
    staPause = false;

    if (pistaActual == 1) {
      pistaActual += myDFPlayer.readFileCountsInFolder(folder);
    }
    pistaActual -= 1;
    myDFPlayer.playFolder(folder, pistaActual);
    while (digitalRead(btnPrevious) == HIGH);
  }

  // NEXT
  if (digitalRead(btnNext) == HIGH && !staInicio) {
    repetir = false;
    staPause = false;

    if (aleatorio) {
      pistaActual = fileAleatorio();
      myDFPlayer.playFolder(folder, pistaActual);

    } else {
      if (pistaActual == myDFPlayer.readFileCountsInFolder(folder)) {
        pistaActual = 0;
      }
      pistaActual += 1;
      myDFPlayer.playFolder(folder, pistaActual);
    }
    while (digitalRead(btnNext) == HIGH);
  }

  // VOLUMEN
  vVolumen = map(analogRead(A3), 0, 1023, 0, 30);
  if (vVolumen != vVolumen_ant && !staInicio)
  {
    myDFPlayer.volume(vVolumen);
    vVolumen_ant = vVolumen;
  }


  // MENU DE CONFIGURACION
  if (digitalRead(btnMode1) == HIGH && !staMenu) {
    staMenu = true;
    posMenu = 1;
    while (digitalRead(btnMode1) == HIGH);

  } else if (digitalRead(btnMode1) == HIGH && staMenu) {
    if (posMenu < 5) { // Numero de opciones en el menu
      posMenu += 1;
    }
    else {
      posMenu = 1;
    }
  }

  if (digitalRead(btnMode2) == HIGH && staMenu) {
    switch (posMenu) {
      case 1:
        if (aleatorio) {
          aleatorio = false;
        } else {
          aleatorio = true;
        }
        break;
      case 2:
        if (repetir) {
          repetir = false;
        } else {
          repetir = true;
        }
        break;
      case 3:
        if (folder > 2)
        {
          folder = 1;
        } else
        {
          folder += 1;
        }
        break;
      case 4:
        myDFPlayer.reset();
        if (fuente == "USB") {
          myDFPlayer.outputDevice(DFPLAYER_DEVICE_SD);          
          fuente = "SD";
        } else {
          myDFPlayer.outputDevice(DFPLAYER_DEVICE_FLASH);
          fuente = "USB";
        }
        vVolumen = map(analogRead(A3), 0, 1023, 0, 30);
        staMenu = false;
        staInicio = true;

        break;
      case 5:
        staMenu = false;
        break;
      default:
        break;
    }
  }

  // MOSTRAR PANTALLA
  if (!staInicio) {

    display.clearDisplay();
    display.setTextColor(WHITE);
    mostrarPantalla();
    display.display();
  }
  delay(1000);
}


// FUNCIONES ================================================

// AUTO NEXT
void autoNext() {
  if (repetir) {
    myDFPlayer.playFolder(folder, pistaActual);
  } else {
    if (aleatorio) {
      pistaActual = fileAleatorio();
      myDFPlayer.playFolder(folder, pistaActual);

    } else {
      if (pistaActual == myDFPlayer.readFileCountsInFolder(folder)) {
        pistaActual = 0;
      }
      pistaActual += 1;
      myDFPlayer.playFolder(folder, pistaActual);
    }
  }
}

void mostrar(int col, int fila, int dat) {
  display.setTextColor(WHITE);
  display.setCursor(col * 6, fila * 8); // ubica cursor en inicio de coordenadas X,Y
  display.print(dat);
}

void mostrar(int col, int fila, String dat) {
  display.setTextColor(WHITE);
  display.setCursor( col * 6, fila * 8); // ubica cursor en inicio de coordenadas X,Y
  display.print(dat);
}

// ----------------------------
void mostrarPantalla()
{
  if (staPause && !staInicio) {
    if (!staMenu) {
      mostrar(6, 4, "Track:");
      mostrar(13, 4, pistaActual);
    }
  } else {
    mostrar(11, 7, "Track:");
    mostrar(18, 7, pistaActual);
  }


  mostrar(0, 0, "Dir:");
  mostrar(4, 0, folder);
  mostrar(0, 7, fuente);

  display.setTextColor(WHITE);
  display.drawBitmap(102, 0, imgvol, 12, 8, WHITE);
  mostrar(19, 0, vVolumen);

  if (aleatorio) {
    display.drawBitmap(84, 0, aleatoriov, 12, 8, WHITE);
  }
  else {
    display.drawBitmap(84, 0, aleatoriof, 12, 8, WHITE);
  }

  if (repetir) {
    display.drawBitmap(66, 0, imgloop, 12, 8, WHITE);
  }
  else {
    mostrar(11, 0, "  ");
  }

  if (digitalRead(staModule_apagado) == LOW && !staMenu) // Cuando el modulo esta reproduciendo.
  {
    contOnda += 1;

    if (contOnda == 1) {
      display.drawBitmap(38, 10, onda1, 50, 33, WHITE);
    } else if (contOnda == 2) {
      display.drawBitmap(38, 10, onda2, 50, 33, WHITE);
    } else if (contOnda == 3) {
      display.drawBitmap(38, 10, onda3, 50, 33, WHITE);
    } else {
      display.drawBitmap(35, 10, onda4, 50, 33, WHITE);
    }
    if (contOnda == 4) {
      contOnda = 0;
    }
  }

  if (staMenu) {
    mostrar(2, 1, "Aleatorio:");
    mostrar(12, 1, aleatorio);
    mostrar(2, 2, "Repetir:");
    mostrar(10, 2, repetir);
    mostrar(2, 3, "Directorio:");
    mostrar(13, 3, folder);
    mostrar(2, 4, "Fuente:");
    mostrar(9, 4, fuente);
    mostrar(2, 5, "Salir");
    display.drawBitmap(0, posMenu * 8, aleatoriof, 12, 8, WHITE);
  }
}

// ----------------------------
int fileAleatorio() {
  return  random(1, myDFPlayer.readFileCountsInFolder(folder));
}

// ----------------------------
int centrarText(String text) {
  return 64 - (text.length() * 6) / 2;
}

// ----------------------------
void printDetail(uint8_t type, int value) {
  switch (type) {
    case TimeOut:
      Serial.println(F("¡Se acabó el tiempo!"));
      break;
    case WrongStack:
      Serial.println(F("¡Pila mal!"));
      break;
    case DFPlayerCardInserted:
      Serial.println(F("¡Tarjeta insertada!"));
      staPause = true;
      break;
    case DFPlayerCardRemoved:
      Serial.println(F("¡Tarjeta removida!"));
      if (fuente == "SD") {
        myDFPlayer.outputDevice(DFPLAYER_DEVICE_FLASH);
        fuente = "USB";
        staMenu = false;
        staInicio = true;
      }
      break;
    case DFPlayerCardOnline:
      Serial.println(F("¡Tarjeta en linea!"));
      staPause = true;
      break;
    case DFPlayerPlayFinished:
      Serial.print(F("Numero: "));
      Serial.println(value);
      Serial.println(F("¡Reproducion terminada!"));
      if (!staInicio) {
        autoNext();
      }
      break;
    case DFPlayerError:
      Serial.print(F("DFPlayerError:"));
      switch (value) {
        case Busy:
          Serial.println(F("Tarjeta no encontrada"));
          if (fuente == "SD") {
            fuente = "USB";
            staInicio = true;
          }
          break;
        case Sleeping:
          Serial.println(F("Durmiendo"));
          break;
        case SerialWrongStack:
          Serial.println(F("Obtener pila incorrecta"));
          break;
        case CheckSumNotMatch:
          Serial.println(F("Compruebe que la suma no coincide"));
          break;
        case FileIndexOut:
          Serial.println(F("Indice de archivo fuera de limites"));
          pistaActual = fileAleatorio();
          break;
        case FileMismatch:
          Serial.println(F("No se puede encontrar el archivo"));
          pistaActual = fileAleatorio();
          break;
        case Advertise:
          Serial.println(F("En Anunciar"));
          break;
        default:
          Serial.println(F("Error"));
          break;
      }
      break;
    default: // Evento con el USB u otro que no tiene que ver con la SD
      staPause = true;
      break;
  }
}
